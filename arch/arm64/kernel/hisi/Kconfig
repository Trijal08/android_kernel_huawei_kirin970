## arch/arm64/kernel/hisi/Kconfig
```kconfig
# SPDX-License-Identifier: GPL-2.0

config HAVE_HW_BREAKPOINT_ADDR_MASK
    bool
    depends on HAVE_HW_BREAKPOINT

config HISI_WORKAROUND_MONITOR
	bool "Hisilicon workaround monitor" if EXPERT
	default n
	help
	  Hisilicon optimizations for cpu workaround

config HISI_HARDEN_BRANCH_PREDICTOR
	bool "Hisilicon Harden the branch predictor solution" if EXPERT
	default n
	depends on HARDEN_BRANCH_PREDICTOR
	depends on HISI_WORKAROUND_MONITOR
	help
	  Hisilicon optimizations for harden branch predictor schema.
```

## fs/proc/hisi/Kconfig
```kconfig
if PROC_FS=y

menuconfig HISI_PROC
	bool "hisilicon proc support"
	depends on PROC_FS
	help
	  select hisilicon proc.

config HISI_PROC_HARDWARE
	bool "/proc/hardware support"
	depends on HISI_PROC && OF
	help
	  read the /proc/hardware to get hardware info.

config HISI_PROC_MEMORYINFO_FAST
	bool "/proc/meminfo_lite support"
	depends on HISI_PROC && OF
	default n
	help
	  offer a fast way to get system memory info(free and aviliable)

endif # PROC_FS

config MEMCG_PROTECT_LRU
	bool "Memory Resource Controller Protect LRU file pages"
	depends on MEMCG && !TRANSPARENT_HUGEPAGE && !HUGETLB_PAGE && (ARM64 || X86_64)
	default n
	help
	  Protect LRU support. It's between normal lru and mlock,
	  that means we will reclaim protect lru file pages as late as possible.
```

## kernel/hisi/Kconfig
```kconfig
config HW_CGROUP_PIDS
	bool "PIDs cgroup subsystem"
	help
	  Provides enforcement of process number limits in the scope of a
	  cgroup. Any attempt to fork more processes than is allowed in the
	  cgroup will fail. PIDs are fundamentally a global resource because it
	  is fairly trivial to reach PID exhaustion before you reach even a
	  conservative kmemcg limit. As a result, it is possible to grind a
	  system to halt without being limited by other cgroup policies. The
	  PIDs cgroup subsystem is designed to stop this from happening.
	  It should be noted that organisational operations (such as attaching
	  to a cgroup hierarchy will *not* be blocked by the PIDs subsystem),
	  since the PIDs limit only affects a process's ability to fork, not to
	  attach to a cgroup.

config CGROUP_IOLIMIT
	bool "IO bandwidth limit cgroup subsystem"
	help
	  Provides a cgroup implementing for io bandwidth while a process
	  in the cgroup read or write.

config HW_CGROUP_WORKINGSET
        bool "workingset cgroup subsystem"
        depends on CRYPTO_CRC32C
        depends on TASK_DELAY_ACCT
        help
          Provides a cgroup implementing filepage collector and prereader of workingset.
          This cgroup workingset for application, collect it touched filepages and
          preread those filepages.

config HW_IAWARE_THREAD_BOOST
    bool "iaware 2.0 binder thread boost"
    default n
    help
      if set, binder thread will be set to new group. if thread is in background group, set it to foreground group, else set it to boost group.

config HW_QOS_THREAD
    bool "iaware 5.0 qos thread"
    default n
    help
      if set, qos thread is propagated by lock&binder, and picked first in lock's waitlist

config HW_VIP_THREAD
	bool "iaware 2.0 vip thread"
	default n
	help
	  if set, vip thread is pick first in cfs sched policy
```

## kernel/sched/hisi/Kconfig
```kconfig
#
# Enhanced options for sched walt
#

config HUAWEI_SCHED_VIP
	bool "Support a high prio sched policy in fair sched class"
	default y
	depends on HISI_EAS_SCHED

config HUAWEI_SCHED_VIP_STRICT
	bool "strict vip policy"
	default n
	depends on HUAWEI_SCHED_VIP

config SCHED_DEPRECATED
	bool "Sched optimization deprecated code"
	default n
	help
	  Due to old platforms still alive, these code can't be deleted now.
	  They have been deprecated in the new platform.

	  New platform, say no. If unsure, say Y.

config SCHED_STAT_YIELD
	bool "Report task's cumulative_yield_time"
	depends on PERF_CTRL
	default n
```

## security/hkip_atkinfo/Kconfig
```kconfig
config HKIP_ATKINFO
	bool "Upload HKIP attack information"
	depends on HHEE || HUAWEI_HKIP
	default n
	help
	  Say yes to enable HKIP attack information to Huawei server.
	  the attacked type is included disable WXN, disable MMU,
	  modify kernel code, modify kernel page table.
	  if you not sure, choose n.
```
