## drivers/gpu/arm/Kconfig
```kconfig
#
# (C) COPYRIGHT 2012 ARM Limited. All rights reserved.
#
# This program is free software and is provided to you under the terms of the
# GNU General Public License version 2 as published by the Free Software
# Foundation, and any use by you of this program is subject to the terms
# of such GNU licence.
#
# A copy of the licence is included with the program, and can also be obtained
# from Free Software Foundation, Inc., 51 Franklin Street, Fifth Floor,
# Boston, MA  02110-1301, USA.
#
#

config MALI_HEIMDALL
        tristate "Mali tHEx configs"
        default n

menu "ARM GPU Configuration"

if MALI_HEIMDALL
source "drivers/gpu/arm/bifrost-r18p0-01rel0/Kconfig"
endif

endmenu
```

## drivers/hisi/Kconfig
```kconfig
menu "Hisilicon platform"

menuconfig HISILICON_PLATFORM
	bool "Hisilicon platform support"
	default n
	help
	  Say yes here to support the hisilicon platform

config HISI_INC_MODEM_CONFIG
        bool "whether or not to include modem config for kernel"
        default n
        help
           Say 'Y' if you want to include modem config.
               so kernel modem can be compiled.
           Say 'N' if you don't want to include modem config,
               so skip modem config check in check_menuconfig.
           Suggestion is to say 'N' in kernel config and "Y' in modem.

if HISILICON_PLATFORM

source "drivers/hisi/accurate_delay/Kconfig"
source "drivers/hisi/adc/Kconfig"
source "drivers/hisi/bootdevice/Kconfig"
source "drivers/hisi/cmdline/Kconfig"
source "drivers/hisi/cpuload/Kconfig"
source "drivers/hisi/da_combine/Kconfig"
source "drivers/hisi/da_combine_dsp/Kconfig"
source "drivers/hisi/ddrc/Kconfig"
source "drivers/hisi/drmdriver/Kconfig"
source "drivers/hisi/dsm/Kconfig"
source "drivers/hisi/dubai/Kconfig"
source "drivers/hisi/efuse/Kconfig"
source "drivers/hisi/emcom/Kconfig"
source "drivers/hisi/hhee/Kconfig"
source "drivers/hisi/hifi_dsp/Kconfig"
source "drivers/hisi/hifi_mailbox/Kconfig"
source "drivers/hisi/hisee/Kconfig"
source "drivers/hisi/hisi_lmk/Kconfig"
source "drivers/hisi/hwbootfail/Kconfig"
source "drivers/hisi/hwerecovery/Kconfig"
source "drivers/hisi/hwfdleak/Kconfig"
source "drivers/hisi/hwmemcheck/Kconfig"
source "drivers/hisi/hwnet/Kconfig"
source "drivers/hisi/hwusb/Kconfig"
source "drivers/hisi/hw_vote/Kconfig"
source "drivers/hisi/hwzerohung/Kconfig"
source "drivers/hisi/ics/Kconfig"
source "drivers/hisi/isp/Kconfig"
source "drivers/hisi/ivp/Kconfig"
source "drivers/hisi/jpu/Kconfig"
source "drivers/hisi/load_image/Kconfig"
source "drivers/hisi/log/Kconfig"
source "drivers/hisi/mailbox/Kconfig"
source "drivers/hisi/memory_dump/Kconfig"
source "drivers/hisi/mntn/Kconfig"
if HISI_INC_MODEM_CONFIG
-source "drivers/hisi/modem/Kconfig"
endif
source "drivers/hisi/noc/Kconfig"
source "drivers/hisi/perf_ctrl/Kconfig"
source "drivers/hisi/perfhub/Kconfig"
source "drivers/hisi/pm/Kconfig"
source "drivers/hisi/rpmb/Kconfig"
source "drivers/hisi/secs_power_ctrl/Kconfig"
source "drivers/hisi/slimbus/Kconfig"
source "drivers/hisi/soundtrigger/Kconfig"
source "drivers/hisi/spmi_hisi/Kconfig"
source "drivers/hisi/storage_rofa/Kconfig"
source "drivers/hisi/switch/Kconfig"
source "drivers/hisi/syscounter/Kconfig"
source "drivers/hisi/timekeeper/Kconfig"
source "drivers/hisi/tlb_conflict/Kconfig"
source "drivers/hisi/tzdriver/Kconfig"

endif #HISILICON_PLATFORM

endmenu
```

## drivers/hisi/hwnet/Kconfig
```kconfig
source "drivers/hisi/hwnet/booster/Kconfig"
source "drivers/hisi/hwnet/chr/Kconfig"
source "drivers/hisi/hwnet/hw_dpi_mark/Kconfig"
source "drivers/hisi/hwnet/ipv4/Kconfig"
source "drivers/hisi/hwnet/netqos_sched/Kconfig"
source "drivers/hisi/hwnet/network_aware/Kconfig"
source "drivers/hisi/hwnet/waudio/Kconfig"
```

## drivers/hisi/ics/Kconfig
```kconfig
#
# Cambricon IPU Platform Specific Drivers
#

menuconfig HISI_ICS_IPU_PLATFORM
	bool "Platform support for Cambricon IPU Device"
	default y
	help
	  Say Y here to get to see options for device drivers of various
	  Cambricon IPU platforms. This option itself does not add any kernel code.

	  If you say N, all options in this submenu will be skipped and disabled.

if HISI_ICS_IPU_PLATFORM

comment "'Cambricon IPU Driver' and 'HISI NPU V200 Support' are mutually exclusive, only one choice!"

config HISI_ICS_IPU
	tristate "Cambricon IPU Driver"
	default y
	help
	  Cambricon IPU Platform driver.

endif # HISI_ICS_IPU_PLATFORM
```

## drivers/hisi/isp/Kconfig
```kconfig
config HISP_DPM
	tristate "HISP DPM(digital power monitor) support"
	depends on DPM_HWMON
	default n
	help
		This framebuffer driver supports dpm function.
```

## drivers/hisi/ivp/Kconfig
```kconfig
menu "IVP"

config DEV_IVP
     bool "ivp support"
     default n
     help
          ivp driver for ivpv300.

config IVP_SMMU
	bool "IVP SMMU Support"
	depends on IOMMU_API
	depends on HISI_IODOMAIN_API
	help
	  IVP IOMMU Support.

config IVP_IVPV160
	bool "ivpv160"
	depends on DEV_IVP

endmenu
```

## drivers/hisi/pm/Kconfig
```kconfig
menu "S/R Options"
choice
	prompt "Select S/R Architecture"
	default SR_OLD_ARCH
	config SR_OLD_ARCH
		bool "select old sr arch"
endchoice

if SR_OLD_ARCH
	source "drivers/hisi/pm/old/Kconfig"
endif
endmenu
```

## drivers/huawei_platform/net/Kconfig
```kconfig
config HW_WIFI
	bool "Huawei wifi tcp monitor support"
	default n

config HUAWEI_MSS_AUTO_CHANGE
        bool "Huawei MSS auto change function support"
        default n

config HW_SYN_LINEAR_RETRY
        bool "Huawei tcp syn sent linear retry support"
        default n

source "drivers/huawei_platform/net/hw_netfilter/Kconfig"
source "drivers/huawei_platform/net/netbooster/Kconfig"
source "drivers/huawei_platform/net/himos/Kconfig"
source "drivers/huawei_platform/net/bastet/Kconfig"
```

## drivers/huawei_platform/power/Kconfig
```kconfig
source "drivers/huawei_platform/power/charger/Kconfig"
source "drivers/huawei_platform/power/hardware_ic/Kconfig"
source "drivers/huawei_platform/power/hw_kstate/Kconfig"
source "drivers/huawei_platform/power/pid_socket/Kconfig"
source "drivers/huawei_platform/power/wifi_filter/Kconfig"
```

## drivers/huawei_platform/power/charger/charger_ap/wireless_charger/Kconfig
```kconfig
#
# wireless charger driver
#

config WIRELESS_IDTP9221
	bool "wireless idt9221"
	default n
	help
	  Say Y here to enable idt9221 driver.
	  The idt9221 is an soc for magnetic induction
	  based wireless power receiver. it is fully compliant
	  with latest WPC Qi specification of BPP and EPP
	  and also supports various proprietary fast charging
	  protocols used by major smart phone OEM.
```

## drivers/huawei_platform/usb/Kconfig
```kconfig
source "drivers/huawei_platform/usb/switch/Kconfig"
source "drivers/huawei_platform/usb/typec/Kconfig"
source "drivers/huawei_platform/usb/pd/Kconfig"
source "drivers/huawei_platform/usb/superswitch/Kconfig"
source "drivers/huawei_platform/usb/hw_pogopin/Kconfig"
source "drivers/huawei_platform/usb/hw_ycable/Kconfig"
```

## drivers/power/hisi/charger/Kconfig
```kconfig
config SCHARGER
	bool "pmic charger"
	default n
config SCHARGER_V300
	bool "schargerV300"
	default n
config CHARGER_SYS_WDG
	bool "pmic charger sys watchdog"
	default n
config CHARGER_WDG
	bool "hisi charger watchdog"
	default n
```

## mm/hisi/Kconfig
```kconfig
menuconfig HISI_MM
	bool "Hisilicon MM support"
	---help---
	  This option add some hisilicon mm codes, needed by following modules.

if HISI_MM

config HISI_SLOW_PATH_COUNT
	bool "page alloc enter slow path count"
	default n
	help
	  Say 'Y' here is you want to count page alloc slow path.

endif

config HISI_PAGE_TRACE
	bool "HISI page trace"
	---help---
	  This option enables hisi page trace, needed by memleak check modules.

config HISI_PAGE_TRACE_TEST
	bool "HISI page trace test"
	depends on HISI_PAGE_TRACE
	---help---
	  This option enables hisi page trace test, needed by hisi page trace modules.

config REFAULT_IO_VMSCAN
	bool "Refault io vmscan"
	default n
	---help---
	  This is a new vmscan algorithm to balance anon and file lru reclaim ratio by
	  detect file and anon refault cost. This can more effectivity reclaim memory and
	  decrease totoal refault count and maybe decrease system cost.
```
